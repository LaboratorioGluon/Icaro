
#include "sensors.h"
#include "system.h"
#include "math.h"
#include <esp_log.h>

SensorData sensorData;

Bmi160 bmi160;
bme280_dev bme280;
Bz251 bz251;

ads1115_t ads1115_cfg = {
    .reg_cfg = ADS1115_CFG_MS_MODE_SS | ADS1115_CFG_LS_DR_128SPS | ADS1115_CFG_MS_MUX_DIFF_AIN0_AIN1 | ADS1115_CFG_MS_PGA_FSR_1_024V,
    .dev_addr = 0x48,
};

const static uint16_t Pt100_table[1051] = {
    1852, 1896, 1939, 1982, 2025, 2068, 2111, 2154, 2197, 2240,
    2283, 2326, 2369, 2412, 2455, 2497, 2539, 2582, 2625, 2667,
    2710, 2752, 2795, 2837, 2880, 2922, 2965, 3007, 3049, 3092,
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    38755, 38784, 38813, 38842, 38872, 38901, 38931, 38961, 38990, 39019,
    39048 // Pt100 resistance * 100 at 850C
};

const int PT100_TABLE_MAXIDX = ((sizeof(Pt100_table) / sizeof(uint16_t)) - 1) ;

BME280_INTF_RET_TYPE main_i2c_read(uint8_t reg_addr, uint8_t *reg_data, uint32_t len, void *intf_ptr)
{
    ESP_ERROR_CHECK(i2c_master_transmit(i2cDeviceBme280, &reg_addr, 1, -1));
    ESP_ERROR_CHECK(i2c_master_receive(i2cDeviceBme280, reg_data, len, -1));

    return BME280_INTF_RET_SUCCESS;
}

BME280_INTF_RET_TYPE main_i2c_write(uint8_t reg_addr, const uint8_t *reg_data, uint32_t len,
                                    void *intf_ptr)
{
    uint8_t buf[50];
    buf[0] = reg_addr;
    memcpy(&buf[1], reg_data, len);

    esp_err_t err = i2c_master_transmit(i2cDeviceBme280,
                                        buf,
                                        len + 1,
                                        -1);

    if (err == ESP_OK)
    {
        return BME280_INTF_RET_SUCCESS;
    }
    return -1;
}

void main_bmi_delay(uint32_t period, void *intf_ptr)
{
    if (period < 10)
    {
        period = 10;
    }
    vTaskDelay(pdMS_TO_TICKS(period));
}

void bmi160_init()
{
    bmi160.init({SPI2_HOST, GPIO_NUM_23, GPIO_NUM_19, GPIO_NUM_18, GPIO_NUM_5, 1000000});
    bmi160.calibrate(5000);
}

void bme280_init()
{
    int8_t status;

    bme280.intf = BME280_I2C_INTF;
    bme280.delay_us = main_bmi_delay;
    bme280.read = main_i2c_read;
    bme280.write = main_i2c_write;

    status = bme280_init(&bme280);
    ESP_LOGE("BME280", "Init status: %d", status);

    bme280_settings settings;

    bme280_get_sensor_settings(&settings, &bme280);

    settings.osr_h = BME280_OVERSAMPLING_1X;
    settings.osr_p = BME280_OVERSAMPLING_16X;
    settings.osr_t = BME280_OVERSAMPLING_2X;
    settings.filter = BME280_FILTER_COEFF_16;
    settings.standby_time = BME280_STANDBY_TIME_0_5_MS;

    bme280_set_sensor_settings(BME280_SEL_ALL_SETTINGS, &settings, &bme280);

    bme280_set_sensor_mode(BME280_POWERMODE_NORMAL, &bme280);
}

esp_err_t bz251_init(void)
{
    Bz251Config conf;
    conf.uartNum = UART_NUM_2;
    conf.timeZone = 1; // Timezone UTC +1
    conf.hasGps = 0;   // Disable GPS
    conf.dynmodel = 6; // Airborne with <1g acceleration

    bz251.init(conf);

    return ESP_OK;
}

void sensors_init()
{
    bz251_init();
    bme280_init();
    bmi160_init();
    ADS1115_initiate(&ads1115_cfg);
}

float sensors_pt100RtoT(float R)
{
    uint32_t j = 0;
    uint32_t i = PT100_TABLE_MAXIDX;
    uint32_t ti;

    R = R * 100;
    
    do{
        ti = (i + j )/2;
        if( Pt100_table[ti] < R)
        {
            j = ti;
        }
        else
        {
            i = ti;
        }
    } while( (i-j) > 1 );
    
    
    uint32_t Ti = -200 + i;
    uint32_t Tj = -200 + j;
    
    float interT = (Ti - Tj)/((float)(Pt100_table[i]-Pt100_table[j]))*(R-Pt100_table[j]) + Tj;
    return interT;
}
//31.25e-6, 0.207f, 3.237f, 1004.0f
float sensors_AdsToTemp(uint16_t val, float gainFsr, float vb, float vcc, float r1)
{
    // DeltaV measured by the sensor
    float dv = val * gainFsr;
    float Z = dv + vb;
    float R = (Z * r1) / (vcc - Z);

    // Calculate temperature in Celsius
    return sensors_pt100RtoT(R);
}

void sensors_getPt100(float &pt100_1, float &pt100_2)
{
    int32_t adcValue;
    // ADS1115 request differential conversion between AIN0 and AIN1
    ESP_ERROR_CHECK(ADS1115_request_diff_AIN0_AIN1());
    
    // Wait for conversion to complete
    while (!ADS1115_get_conversion_state())
        vTaskDelay(pdMS_TO_TICKS(5));

    adcValue = ADS1115_get_conversion();
    //ESP_LOGE("SENSORS", "PT100_1: %ld", adcValue);
    // Get the conversion value and convert to temperature
    sensorData.pt100_1 = sensors_AdsToTemp(
        adcValue,
        31.25e-6, 0.207f, 3.237f, 1004.0f);
    
    // ADS1115 request differential conversion between AIN0 and AIN1
    ESP_ERROR_CHECK(ADS1115_request_diff_AIN2_AIN3());

    // Wait for conversion to complete
    while (!ADS1115_get_conversion_state())
        vTaskDelay(pdMS_TO_TICKS(5));

    adcValue = ADS1115_get_conversion();
    //ESP_LOGE("SENSORS", "PT100_2: %ld", adcValue);

    sensorData.pt100_2 = sensors_AdsToTemp(
        adcValue,
        31.25e-6, 0.207f, 3.237f, 1004.0f);
        
}

void debugSensorData()
{
    // Print sensor data in differente lines:
    ESP_LOGE("SENSORS", "Timestamp: %lld", sensorData.timestamp);
    ESP_LOGE("SENSORS", "PT100: %.2f %.2f", sensorData.pt100_1, sensorData.pt100_2);
    ESP_LOGE("SENSORS", "BME280: %.2f %.2f %.2f",
             sensorData.bme.temperature,
             sensorData.bme.pressure,
             sensorData.bme.humidity);
    ESP_LOGE("SENSORS", "BMI160: %.2f %.2f %.2f %.2f %.2f %.2f", sensorData.acc.x, sensorData.acc.y, sensorData.acc.z, sensorData.gyr.x, sensorData.gyr.y, sensorData.gyr.z);
    ESP_LOGE("SENSORS", "BZ251: %f %f %f", sensorData.gps.latitude, sensorData.gps.longitude, sensorData.gps.altitude);
    ESP_LOGE("SENSORS", "BZ251 Time: %02d:%02d",
             sensorData.gps.hour,
             sensorData.gps.minute);
    ESP_LOGE("SENSORS", "BZ251 Date: %02d/%02d/%02d",
             sensorData.gps.day,
             sensorData.gps.month,
             sensorData.gps.year);
    ESP_LOGE("SENSORS", "BZ251 Satellites: %d | %d", sensorData.gps.satellites, sensorData.gps.valid);

}